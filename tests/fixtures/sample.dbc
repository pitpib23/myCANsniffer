VERSION "cansniff-test"

NS_ :

BS_:

BU_: ECU1 ECU2

BO_ 256 Engine: 8 ECU1
 SG_ Rpm : 0|16@1+ (0.25,0) [0|16383.75] "rpm" ECU2
 SG_ CoolantTemp : 16|8@1+ (1,-40) [-40|215] "degC" ECU2
 SG_ Torque : 24|16@0- (0.5,0) [-8192|8191.5] "Nm" ECU2
 SG_ Gear : 40|4@1+ (1,0) [0|15] "" ECU2

BO_ 257 Status: 4 ECU1
 SG_ Mode : 0|2@1+ (1,0) [0|3] "" ECU2
 SG_ Ready : 2|1@1+ (1,0) [0|1] "" ECU2

BO_ 2566844926 Extended: 8 ECU1
 SG_ BigCounter : 0|32@1+ (1,0) [0|4294967295] "" ECU2

BO_ 512 Multiplexed: 8 ECU1
 SG_ Selector M : 0|8@1+ (1,0) [0|255] "" ECU2
 SG_ TempA m0 : 8|16@1+ (0.1,0) [0|6553.5] "degC" ECU2
 SG_ VoltB m1 : 8|16@1+ (0.001,0) [0|65.535] "V" ECU2

CM_ BO_ 256 "Engine operating data";
CM_ SG_ 256 Rpm "Crankshaft speed";

VAL_ 257 Mode 0 "Off" 1 "Standby" 2 "Running" 3 "Fault" ;
VAL_ 256 Gear 0 "Neutral" 1 "First" 2 "Second" 15 "Reverse" ;
